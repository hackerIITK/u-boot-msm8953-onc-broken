## configs/msm8953_onclite_defconfig
```kconfig
CONFIG_ARM=y
CONFIG_SYS_BOARD="msm8953"
CONFIG_SYS_VENDOR="qualcomm"
CONFIG_SYS_CONFIG_NAME="msm8953_onclite"
CONFIG_SKIP_LOWLEVEL_INIT=y
CONFIG_POSITION_INDEPENDENT=y
CONFIG_LINUX_KERNEL_IMAGE_HEADER=y
CONFIG_TEXT_BASE=0x80080000
CONFIG_SYS_INIT_SP_BSS_OFFSET=0x180000
CONFIG_ARCH_SNAPDRAGON=y
CONFIG_NR_DRAM_BANKS=24
CONFIG_DEFAULT_DEVICE_TREE="qcom/msm8953-xiaomi-onclite"
CONFIG_SYS_LOAD_ADDR=0xA0000000
CONFIG_BUTTON_CMD=y
CONFIG_FIT=y
CONFIG_FIT_VERBOSE=y
CONFIG_BOOTSTD_FULL=y
CONFIG_BOOTDELAY=1
CONFIG_OF_BOARD_SETUP=y
CONFIG_USE_PREBOOT=y
CONFIG_SAVE_PREV_BL_INITRAMFS_START_ADDR=y
CONFIG_SYS_CBSIZE=512
CONFIG_LOG_MAX_LEVEL=9
CONFIG_LOG_DEFAULT_LEVEL=4
# CONFIG_DISPLAY_CPUINFO is not set
CONFIG_DISPLAY_BOARDINFO_LATE=y
CONFIG_CMD_BOOTMENU=y
CONFIG_CMD_MEMINFO=y
CONFIG_CMD_MEMINFO_MAP=y
CONFIG_CMD_CLK=y
CONFIG_CMD_GPIO=y
CONFIG_CMD_MMC=y
CONFIG_CMD_USB=y
CONFIG_CMD_CAT=y
CONFIG_CMD_LOG=y
CONFIG_OF_LIVE=y
CONFIG_OF_UPSTREAM_BUILD_VENDOR=y
CONFIG_ENV_USE_DEFAULT_ENV_TEXT_FILE=y
CONFIG_ENV_DEFAULT_ENV_TEXT_FILE="board/qualcomm/qcom-phone.env"
CONFIG_BUTTON_QCOM_PMIC=y
CONFIG_PINCTRL=y
CONFIG_PINCTRL_QCOM_GENERIC=y
CONFIG_MSM_SERIAL=y
CONFIG_MSM_GENI_SERIAL=y
# CONFIG_REQUIRE_SERIAL_CONSOLE is not set
CONFIG_NULLDEV_SERIAL=y
CONFIG_CLK=y
CONFIG_CLK_STUB=y
CONFIG_USB_FUNCTION_FASTBOOT=y
CONFIG_FASTBOOT_BUF_ADDR=0xA2000000
CONFIG_FASTBOOT_FLASH=y
CONFIG_FASTBOOT_FLASH_MMC_DEV=0
CONFIG_FASTBOOT_MMC_USER_SUPPORT=y
CONFIG_MSM_GPIO=y
CONFIG_QCOM_PMIC_GPIO=y
CONFIG_DM_KEYBOARD=y
CONFIG_BUTTON_KEYBOARD=y
CONFIG_MMC_SDHCI=y
CONFIG_MMC_SDHCI_MSM=y
CONFIG_USB=y
CONFIG_DM_USB=y
CONFIG_USB_DWC3=y
CONFIG_USB_DWC3_GENERIC=y
CONFIG_USB_GADGET=y
CONFIG_USB_GADGET_DOWNLOAD=y
CONFIG_USB_FUNCTION_ACM=y
CONFIG_DM_VIDEO=y
CONFIG_VIDEO=y
CONFIG_VIDEO_SIMPLE=y
CONFIG_VIDEO_CONSOLE=y
CONFIG_VIDEO_ANSI=y
CONFIG_VIDEO_BPP8=y
CONFIG_VIDEO_BPP16=y
CONFIG_VIDEO_BPP32=y
CONFIG_VIDEO_FONT_16X32=y
CONFIG_CONSOLE_MUX=y
CONFIG_PANIC_HANG=y
CONFIG_CMD_PAUSE=y
CONFIG_BOOT_RETRY=y
CONFIG_BOOT_RETRY_TIME=1
CONFIG_BUTTON_REMAP_PHONE_KEYS=y
CONFIG_RETRY_BOOTCMD=y
```
